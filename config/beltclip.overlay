/*
 * Belt clip - one button wired to Nice!Nano pin P0.31 (D2)
 * Change gpios pin number if you wire to a different pin.
 * Nice!Nano GPIO pinout: https://nicekeyboards.com/docs/nice-nano/pinout-schematic
 */

/ {
    kscan0: kscan {
        compatible = "zmk,kscan-gpio-direct";
        label = "KSCAN";
        input-gpios = <&gpio0 31 (GPIO_ACTIVE_LOW | GPIO_PULL_UP)>;
    };
};
